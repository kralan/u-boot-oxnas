## arch/arm/cpu/arm1136/nas782x/Kconfig
```kconfig
if ARCH_NAS782X

config NAS782X
	bool
	default y

choice
	prompt "NAS782X board select"
	optional

config TARGET_OX820
	bool "ox820"

endchoice

config SYS_SOC
	default "nas782x"

source "board/ox820/Kconfig"

endif
```

## board/ox820/Kconfig
```kconfig
if TARGET_OX820

choice
	prompt "Boot option select"
	bool
	default BOOT_FROM_NAND

config BOOT_FROM_NAND
	bool "Boot from NAND"

config BOOT_FROM_SATA
	bool "Boot from SATA"

config BOOT_FROM_EXT4
	bool "Boot from EXT4"

config BOOT_FROM_FAT
	bool "Boot from FAT"

endchoice

config SYS_BOARD
	default "ox820"

#config SYS_VENDOR
#	default "OXNAS"
#

config SYS_CONFIG_NAME
	default "ox820"

endif
```

## configs/ox820_defconfig
```kconfig
CONFIG_ARM=y
CONFIG_ARCH_NAS782X=y
CONFIG_TARGET_OX820=y
CONFIG_BOOT_FROM_NAND=y
CONFIG_SPL=y
CONFIG_SYS_PROMPT="OX820> "
# CONFIG_CMD_IMLS is not set
# CONFIG_CMD_FLASH is not set
CONFIG_CMD_SETEXPR=y
CONFIG_USB=y
CONFIG_USB_EHCI=y
CONFIG_USB_STORAGE=y
CONFIG_CMD_USB=y
```
